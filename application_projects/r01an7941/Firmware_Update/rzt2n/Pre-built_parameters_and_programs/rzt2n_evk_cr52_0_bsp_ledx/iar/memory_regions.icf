
            /* generated memory regions file - do not edit */
                            define symbol ATCM_CR52_0_START = 0x00000000;
                define symbol ATCM_CR52_0_LENGTH = 0x80000;
                define symbol BTCM_CR52_0_START = 0x00100000;
                define symbol BTCM_CR52_0_LENGTH = 0x10000;
                define symbol SYSTEM_RAM_START = 0x10000000;
                define symbol SYSTEM_RAM_LENGTH = 0x200000;
                define symbol CPU0_ATCM_VIA_AXIS_START = 0x20000000;
                define symbol CPU0_ATCM_VIA_AXIS_LENGTH = 0x80000;
                define symbol CPU0_BTCM_VIA_AXIS_START = 0x20100000;
                define symbol CPU0_BTCM_VIA_AXIS_LENGTH = 0x10000;
                define symbol CPU1_ATCM_VIA_AXIS_START = 0x21000000;
                define symbol CPU1_ATCM_VIA_AXIS_LENGTH = 0x80000;
                define symbol CPU1_BTCM_VIA_AXIS_START = 0x21100000;
                define symbol CPU1_BTCM_VIA_AXIS_LENGTH = 0x10000;
                define symbol xSPI0_CS0_SPACE_START = 0x40000000;
                define symbol xSPI0_CS0_SPACE_LENGTH = 0x8000000;
                define symbol xSPI0_CS1_SPACE_START = 0x48000000;
                define symbol xSPI0_CS1_SPACE_LENGTH = 0x8000000;
                define symbol xSPI1_CS0_SPACE_START = 0x50000000;
                define symbol xSPI1_CS0_SPACE_LENGTH = 0x8000000;
                define symbol xSPI1_CS1_SPACE_START = 0x58000000;
                define symbol xSPI1_CS1_SPACE_LENGTH = 0x8000000;
                define symbol CS0_SPACE_START = 0x70000000;
                define symbol CS0_SPACE_LENGTH = 0x4000000;
                define symbol CS2_SPACE_START = 0x74000000;
                define symbol CS2_SPACE_LENGTH = 0x4000000;
                define symbol CS3_SPACE_START = 0x78000000;
                define symbol CS3_SPACE_LENGTH = 0x4000000;
                define symbol CS5_SPACE_START = 0x7C000000;
                define symbol CS5_SPACE_LENGTH = 0x4000000;
                define symbol PCIE0_MIRROR_START = 0xA0000000;
                define symbol PCIE0_MIRROR_LENGTH = 0x10000000;
                define symbol DDR_MIRROR0_START = 0xC0000040;
                define symbol DDR_MIRROR0_LENGTH = 0x1FFFFFC0;
                define symbol DDR_MIRROR1_START = 0xE0000040;
                define symbol DDR_MIRROR1_LENGTH = 0x1FFFFFC0;
                define symbol DDR_START = 0x200000040;
                define symbol DDR_LENGTH = 0x7FFFFFC0;
                define symbol DDR_CR52_0_START = 0x00000000;
                define symbol DDR_CR52_0_LENGTH = 0x0;
                define symbol PCIE0_START = 0x400000000;
                define symbol PCIE0_LENGTH = 0x200000000;
                define symbol PCIE0_CR52_0_START = 0x00000000;
                define symbol PCIE0_CR52_0_LENGTH = 0x0;
                define symbol NONCACHE_START = 0x10000000;
                define symbol NONCACHE_LENGTH = 0x200000;
                define symbol eSD_eMMC_SPACE_START = 0x88000000;
                define symbol eSD_eMMC_SPACE_LENGTH = 0xC000000;
                    define symbol SECONDARY = 0x00000000;
                define symbol CR52_0 = 1;
