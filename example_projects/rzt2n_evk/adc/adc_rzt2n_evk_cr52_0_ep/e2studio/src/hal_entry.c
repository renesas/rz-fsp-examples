#include "hal_data.h"
#include "common_utils.h"

FSP_CPP_HEADER
void R_BSP_WarmStart(bsp_warm_start_event_t event)
BSP_PLACE_IN_SECTION(".warm_start");
BSP_ATTRIBUTE_STACKLESS void R_BSP_WarmStart_StackLess(void)
BSP_PLACE_IN_SECTION(".warm_start");
FSP_CPP_FOOTER

/*******************************************************************************
 * Macro definitions / enum
 ******************************************************************************/
#define ADC_LEVEL0          (820u)
#define ADC_LEVEL1          (1639u)
#define ADC_LEVEL2          (2458u)
#define ADC_LEVEL3          (3277u)

#define ADC_SAMPLE_SUCCESS  (0)
#define ADC_SAMPLE_FAIL     (1)

#define ADC_SAMPLE_COUNT    (5)         /* Please set the value of 3-18. */
#define ADC_SAMPLE_MIN_VAL  (0u)
#define ADC_SAMPLE_MAX_VAL  (4095)

#if ((ADC_SAMPLE_COUNT < 3) || (ADC_SAMPLE_COUNT > 18))
#error Please set the value of 3-18 to ADC_SAMPLE_COUNT.
#endif

#define LED_ON  (1)
#define LED_OFF (0)

#define LED_UserLED0_PIN (BSP_IO_PORT_13_PIN_3)
#define LED_UserLED1_PIN (BSP_IO_PORT_13_PIN_5)
#define LED_UserLED2_PIN (BSP_IO_PORT_10_PIN_2)
#define LED_UserLED3_PIN (BSP_IO_PORT_10_PIN_3)

typedef enum
{
    LED_UserLED0,
    LED_UserLED1,
    LED_UserLED2,
    LED_UserLED3,
} LED_No_t;

#define UNUSED(x)  ((void) (x))

/*******************************************************************************
 * Private variables and functions
 ******************************************************************************/
static volatile bool adc_end_flg;

static void adc_sample_led_off(void);
static void adc_sample_led_meter(const uint16_t adc_data);

void adc_sample_callback(adc_callback_args_t * p_arg);

static uint16_t adc_sample_ad_open(void);
static uint16_t adc_sample_ad_proc(uint16_t * const p_adc_data);
static void adc_sample_ad_close(void);
static uint16_t adc_sample_calc_average(const uint16_t adc_data[]);

static void led(const uint32_t no, const uint32_t flg);

/*******************************************************************************************************************//**
 * main() is generated by the FSP Configuration editor and is used to generate threads if an RTOS is used.
 * This function is called by main() when no RTOS is used.
 **********************************************************************************************************************/
void hal_entry(void)
{
    /* TODO: add your own code here */
    uint16_t adc_data[ADC_SAMPLE_COUNT];
    int32_t result = ADC_SAMPLE_SUCCESS;
    int32_t count;

    __enable_irq();

    APP_PRINT(BANNER_INFO,
              EP_VERSION,
              4, 2, 0);

    APP_PRINT("\r\nExample Project Overview\r\n");
    APP_PRINT("This example demonstrates ADC conversion and LED indication.\r\n");

    adc_end_flg = false;

    adc_sample_led_off();

    /* Start up the ADC once before the sampling loop. Opening and closing the driver for every
     * single conversion puts the analog block into module stop and restarts it each time, which
     * does not leave it enough time to settle and makes the conversion result unstable. */
    result = adc_sample_ad_open();

    while (ADC_SAMPLE_SUCCESS == result)
    {
        /* Perform A/D conversion ADC_SAMPLE_COUNT times. */
        for (count = 0; (count < ADC_SAMPLE_COUNT) && (ADC_SAMPLE_SUCCESS == result); count++)
        {
            /* A/D conversion. */
            result = adc_sample_ad_proc(&adc_data[count]);
        }

        /* Calculate the average value when the A/D conversion is successful. */
        if (ADC_SAMPLE_SUCCESS == result)
        {
            /* Calculate the average value excluding the minimum and maximum values of the A/D conversion result. */
            uint16_t ave_adc_data;
            ave_adc_data = adc_sample_calc_average(adc_data);

            /* Turn on the LED corresponding to the A/D conversion value. */
            adc_sample_led_meter(ave_adc_data);
        }
    }

    /* Perform ADC driver end processing. */
    adc_sample_ad_close();

    while (1)
    {
        /* Do nothing. */
    }
}

/*******************************************************************************
 * Function Name: adc_sample_led_off
 * Description  : Turn off LED0, LED1, LED2, and LED3.
 * Arguments    : None.
 * Return Value : None.
 ******************************************************************************/
static void adc_sample_led_off(void)
{
    led(LED_UserLED0, LED_ON);
    led(LED_UserLED1, LED_ON);
    led(LED_UserLED2, LED_ON);
    led(LED_UserLED3, LED_ON);

    return;
}
/*******************************************************************************
 * End of function adc_sample_led_off
 ******************************************************************************/

/*******************************************************************************
 * Function Name: adc_sample_led_meter
 * Description  : Control LED0, LED1, LED2, and LED3 according to the A/D conversion value.
 * Arguments    : adc_data -
 *                    A/D conversion value.
 * Return Value : None.
 ******************************************************************************/
static void adc_sample_led_meter(const uint16_t adc_data)
{
    led(LED_UserLED0, (ADC_LEVEL0 < adc_data) ? LED_ON : LED_OFF);
    led(LED_UserLED1, (ADC_LEVEL1 < adc_data) ? LED_ON : LED_OFF);
    led(LED_UserLED2, (ADC_LEVEL2 < adc_data) ? LED_ON : LED_OFF);
    led(LED_UserLED3, (ADC_LEVEL3 < adc_data) ? LED_ON : LED_OFF);

    return;
}
/*******************************************************************************
 * End of function adc_sample_led_meter
 ******************************************************************************/

/*******************************************************************************
 * Function Name: adc_sample_callback
 * Description  : Set the A/D conversion completion flag.
 * Arguments    : p_arg -
 *                    Not used.
 * Return Value : None.
 ******************************************************************************/
void adc_sample_callback(adc_callback_args_t * p_arg)
{
    UNUSED(p_arg);
    adc_end_flg = true;

    return;
}
/*******************************************************************************
 * End of function adc_sample_callback
 ******************************************************************************/

/*******************************************************************************
 * Function Name: adc_sample_ad_open
 * Description  : Start up the ADC and configure the scan parameters.
 *                Called once before the sampling loop so that the analog block
 *                stays running for the whole sequence of conversions.
 * Arguments    : None.
 * Return Value : ADC_SAMPLE_SUCCESS
 *                    ADC start-up was successful.
 *                ADC_SAMPLE_FAIL
 *                    ADC start-up failed.
 ******************************************************************************/
static uint16_t adc_sample_ad_open(void)
{
    fsp_err_t ret = FSP_SUCCESS;

    /* Initialize the ADC settings. */
    ret = R_ADC_Open(&g_adc0_ctrl, &g_adc0_cfg);
    if (FSP_SUCCESS == ret)
    {
        /* Configure the ADC scan parameters. */
        ret = R_ADC_ScanCfg(&g_adc0_ctrl, &g_adc0_channel_cfg);
    }

    if (FSP_SUCCESS == ret)
    {
        return ADC_SAMPLE_SUCCESS;
    }
    else
    {
        /* Release the driver again when the start-up sequence did not complete. */
        R_ADC_Close(&g_adc0_ctrl);

        return ADC_SAMPLE_FAIL;
    }
}
/*******************************************************************************
 * End of function adc_sample_ad_open
 ******************************************************************************/

/*******************************************************************************
 * Function Name: adc_sample_ad_proc
 * Description  : Perform the A/D conversion process.
 * Arguments    : p_adc_data
 *                    Pointer to the variable that contains the A/D conversion result.
 * Return Value : ADC_SAMPLE_SUCCESS
 *                    A/D conversion process was successful.
 *                ADC_SAMPLE_FAIL
 *                    A/D conversion process failed.
 ******************************************************************************/
static uint16_t adc_sample_ad_proc(uint16_t * const p_adc_data)
{
    fsp_err_t ret = FSP_SUCCESS;

    /* Trigger conversion by calling R_ADC_ScanStart(). */
    (void) R_ADC_ScanStart(&g_adc0_ctrl);

    /* Wait for conversion to complete. */
    while (true != adc_end_flg)
    {
        /* Wait for A/D conversion to complete. */
    }
    adc_end_flg = false;

    /* Read converted data. */
    ret = R_ADC_Read(&g_adc0_ctrl, ADC_CHANNEL_0, p_adc_data);

    if (FSP_SUCCESS == ret)
    {
        return ADC_SAMPLE_SUCCESS;
    }
    else
    {
        return ADC_SAMPLE_FAIL;
    }
}
/*******************************************************************************
 * End of function adc_sample_ad_proc
 ******************************************************************************/

/*******************************************************************************
 * Function Name: adc_sample_ad_close
 * Description  : Perform ADC driver end processing.
 * Arguments    : None.
 * Return Value : None.
 ******************************************************************************/
static void adc_sample_ad_close(void)
{
    /* Perform ADC driver end processing. */
    R_ADC_Close(&g_adc0_ctrl);

    return;
}
/*******************************************************************************
 * End of function adc_sample_ad_close
 ******************************************************************************/

/*******************************************************************************
 * Function Name: adc_sample_calc_average
 * Description  : Calculate the average excluding the minimum and maximum A/D conversion values.
 * Arguments    : adc_data
 *                    A/D conversion result values. The number of elements is ADC_SAMPLE_COUNT.
 * Return Value : Average value excluding the minimum and maximum A/D conversion values.
 ******************************************************************************/
static uint16_t adc_sample_calc_average(const uint16_t adc_data[])
{
    int32_t index;
    int32_t min_index = 0;
    int32_t max_index = 0;
    uint16_t min_data = ADC_SAMPLE_MAX_VAL;
    uint16_t max_data = ADC_SAMPLE_MIN_VAL;
    uint16_t ave_adc_data = 0u;

    /* Search for the minimum and maximum values. */
    for (index = 0; index < ADC_SAMPLE_COUNT; index++)
    {
        /* Search for the minimum value. */
        if (min_data > adc_data[index])
        {
            min_data = adc_data[index];
            min_index = index;
        }

        /* Search for the maximum value. */
        if (max_data <= adc_data[index])
        {
            max_data = adc_data[index];
            max_index = index;
        }
    }

    /* Calculate the average value excluding the minimum and maximum values. */
    for (index = 0; index < ADC_SAMPLE_COUNT; index++)
    {
        if ((min_index != index) && (max_index != index))
        {
            ave_adc_data += adc_data[index];
        }
    }

    /* Subtract two because the minimum and maximum values are excluded. */
    ave_adc_data /= (ADC_SAMPLE_COUNT - 2);

    return ave_adc_data;
}
/*******************************************************************************
 * End of function adc_sample_calc_average
 ******************************************************************************/

/*******************************************************************************
 * Function Name: led
 * Description  : Control an LED.
 * Arguments    : no -
 *                    LED number.
 *                flg -
 *                    LED_ON  : LED on.
 *                    LED_OFF : LED off.
 * Return Value : None.
 ******************************************************************************/
static void led(const uint32_t no, const uint32_t flg)
{
    switch (no)
    {
        case LED_UserLED0:
            R_IOPORT_PinWrite(&g_ioport_ctrl, LED_UserLED0_PIN, flg);
            break;
        case LED_UserLED1:
            R_IOPORT_PinWrite(&g_ioport_ctrl, LED_UserLED1_PIN, flg);
            break;
        case LED_UserLED2:
            R_IOPORT_PinWrite(&g_ioport_ctrl, LED_UserLED2_PIN, flg);
            break;
        case LED_UserLED3:
            R_IOPORT_PinWrite(&g_ioport_ctrl, LED_UserLED3_PIN, flg);
            break;

        default:
            /* Do nothing. */
            break;
    }

    return;
}

/*******************************************************************************
 * End of function led
 ******************************************************************************/

/*******************************************************************************************************************//**
 * This function is called at various points during the startup process.  This implementation uses the event that is
 * called right before main() to set up the pins.
 *
 * @param[in] event Where in the startup process the code is currently at.
 **********************************************************************************************************************/
void R_BSP_WarmStart(bsp_warm_start_event_t event)
{
    if (BSP_WARM_START_RESET == event)
    {
        /* Pre-clock initialization. */
    }

    if (BSP_WARM_START_POST_C == event)
    {
        /* C runtime environment and system clocks are set up. */

#if BSP_FEATURE_DDR_SUPPORTED
 #if (1 == BSP_CFG_DDR_INIT_ENABLE)

        /* Initialize the DDR settings. */
        bsp_ddr_init();

 #endif
#endif

        if (NULL != g_bsp_pin_cfg.p_extend)
        {
            /* Configure pins. */
            R_IOPORT_Open(&IOPORT_CFG_CTRL, &IOPORT_CFG_NAME);
        }
    }
}

/*******************************************************************************************************************//**
 * This function is called without a stack at the very beginning of the startup process.
 * All instructions must be written in inline assembly.
 **********************************************************************************************************************/
BSP_ATTRIBUTE_STACKLESS void R_BSP_WarmStart_StackLess(void)
{
    /* The very beginning of the startup process. */

    /* Do not delete. Required to return to system_init. */
#if (0 == BSP_LP64_SUPPORT)
    __asm volatile ("BX lr");
#else
    __asm volatile ("BR lr");
#endif
}
